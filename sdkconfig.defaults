## sdkconfig.defaults
```kconfig
#
# SSD1306 Configuration
#
CONFIG_GPIO_RANGE_MAX=33
CONFIG_I2C_INTERFACE=y
CONFIG_SSD1306_128x64=y
CONFIG_OFFSETX=0
CONFIG_SCL_GPIO=17
CONFIG_SDA_GPIO=16
CONFIG_RESET_GPIO=-1
```
